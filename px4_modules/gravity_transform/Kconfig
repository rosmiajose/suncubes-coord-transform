## px4_modules/gravity_transform/Kconfig
```kconfig
menuconfig MODULES_GRAVITY_TRANSFORM
	bool "gravity_transform"
	default n
	---help---
		Real-time coordinate transformation module (out-of-tree).
```
